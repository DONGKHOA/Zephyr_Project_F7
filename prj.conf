## CMakeLists.txt
```
# SPDX-License-Identifier: Apache-2.0

cmake_minimum_required(VERSION 3.20.0)

set(BOARD stm32f746g_disco)

find_package(Zephyr REQUIRED HINTS $ENV{ZEPHYR_BASE})
project(Zephyr_STM32F7)


# set(LVGL_DIR ${ZEPHYR_LVGL_MODULE_DIR})

add_subdirectory(drivers)

include_directories(gui)

FILE(GLOB app_sources src/*.c)
target_sources(app PRIVATE ${app_sources})

target_sources(app PRIVATE gui/ui_helpers.c)
target_sources(app PRIVATE gui/ui.c)
target_sources(app PRIVATE gui/ui_events.c)
target_sources(app PRIVATE gui/components/ui_comp_hook.c)
target_sources(app PRIVATE gui/screens/ui_Screen1.c)

add_compile_definitions(LV_LVGL_H_INCLUDE_SIMPLE)
```

## prj.conf
```kconfig
CONFIG_MAIN_STACK_SIZE=2048
CONFIG_LOG=y

# LVGL
CONFIG_LVGL=y
CONFIG_LV_Z_MEM_POOL_SIZE=8192

# Display
CONFIG_DISPLAY=y
CONFIG_INPUT=y

# libs
CONFIG_MINIMAL_LIBC=y
CONFIG_CBPRINTF_NANO=y
CONFIG_CBPRINTF_REDUCED_INTEGRAL=y
CONFIG_CBPRINTF_LIBC_SUBSTS=n

# Drivers and peripherals
CONFIG_GPIO=y
CONFIG_I2C=n
CONFIG_WATCHDOG=n
CONFIG_PINCTRL=y
CONFIG_SPI=n
CONFIG_SERIAL=y
CONFIG_FLASH=n

# Power management
CONFIG_PM=y

# Interrupts
CONFIG_DYNAMIC_INTERRUPTS=n
CONFIG_IRQ_OFFLOAD=n

# Memory protection
CONFIG_THREAD_STACK_INFO=n
CONFIG_THREAD_CUSTOM_DATA=n
CONFIG_FPU=n

# Boot
CONFIG_BOOT_BANNER=n
CONFIG_BOOT_DELAY=0

# Console
CONFIG_CONSOLE=n
CONFIG_UART_CONSOLE=n
CONFIG_STDOUT_CONSOLE=n
CONFIG_PRINTK=n
CONFIG_EARLY_CONSOLE=n

# Build 
CONFIG_SIZE_OPTIMIZATIONS=y

CONFIG_ARM_MPU=n
```

## app.overlay
```dts
/{
    aliases {
        led0 = &user_led_0;
        // button0 = &user_button_0;
    };

    leds {
        compatible = "gpio-leds";
        user_led_0:led_0 {
            gpios = < &gpioi 1 GPIO_ACTIVE_LOW >;
        };
    };
    // buttons {
    //     compatible = "gpio-keys";
    //     user_button_0: button_0 {
    //         gpios = < &gpioi 11 GPIO_ACTIVE_HIGH >;
    //     };
    // };
};
```

## src/main.c
```c
#include <stdio.h>
#include <stdint.h>
#include <zephyr/drivers/display.h>
#include <zephyr/kernel.h>
#include <zephyr/logging/log.h>
#include <lvgl.h>
#include "../gui/ui.h"
#include "../drivers/gpio_driver/gpio_driver.h"

LOG_MODULE_REGISTER(app);
#define NODE_LED DT_ALIAS(led0)

static struct gpio_dt_spec led = GPIO_DT_SPEC_GET(NODE_LED, gpios);

gpio_driver_t *led_driver;

int main(void)
{

	led_driver = GPIO_DRIVER_Create(&led);
	led_driver->config_output(led_driver);

	const struct device *display_dev;

	display_dev = DEVICE_DT_GET(DT_CHOSEN(zephyr_display));
	if (!device_is_ready(display_dev)) {
		return 0;
	}
	ui_init();
	ui_Screen1_screen_init();
	lv_task_handler();
	display_blanking_off(display_dev);

    while (1)
    {
		k_msleep(lv_task_handler());
    }
    
    return 0;
}
```
